## devicemodel/vmcfg/Kconfig
```kconfig
mainmenu "VM Configuration"

config VM_CFG
	bool "Enable build-in VM configuration"
	default n
```

## devicemodel/vmcfg/apl-mrb/vm1/Kconfig
```kconfig
config DEFCONFIG_LIST
	string
	option defconfig_list
	default "apl-mrb/vm1/configs/default.config"

menuconfig MRB_VM1
	bool "Build-in VM1 configuration for MRB"
	default n
	depends on VM_CFG

config MRB_VM1_NAME
	string "Name of VM1"
	default "mrb-vm1-aaag"
	depends on MRB_VM1

menuconfig MRB_VM1_UUID
	bool "UUID of VM1"
	default n
	depends on MRB_VM1

config MRB_VM1_UUID_VAL
	string "UUID Value"
	default "2d26d588-485d-11e8-8e17-d368e4b04324"
	depends on MRB_VM1_UUID

config MRB_VM1_ACPI
        bool "create ACPI tables"
        default y
        depends on MRB_VM1

config MRB_VM1_MEM
        int "memory size in MB"
        default 1750
        depends on MRB_VM1

config MRB_VM1_CPU
        int "# cpus (default 1)"
        default 3
        depends on MRB_VM1

menuconfig MRB_VM1_VSBL
        bool "VSBL file"
        default y
        depends on MRB_VM1

config MRB_VM1_VSBL_IMAGE
        string "vsbl path"
        default "/usr/share/acrn/bios/VSBL.bin"
        depends on MRB_VM1_VSBL

menuconfig MRB_VM1_GVT
        bool "GVT Support"
        default y
        depends on MRB_VM1

config MRB_VM1_GVT_DEV
        string "GVT device"
        default "2,pci-gvt"
        depends on MRB_VM1_GVT

config MRB_VM1_GVT_ARG
        string "GVT args"
        default "64 448 8"
        depends on MRB_VM1_GVT

menuconfig MRB_VM1_HOSTBRIDGE
        bool "pci hostbridge"
        default y
        depends on MRB_VM1

config MRB_VM1_HOSTBRIDGE_OPT
        string "optional args"
        default "0:0,hostbridge"
        depends on MRB_VM1_HOSTBRIDGE

menuconfig MRB_VM1_NPK
        bool "NPK device"
        default n
        depends on MRB_VM1_HOSTBRIDGE

config MRB_VM1_NPK_OPT
        string "optional args"
        default "-s 0:0:2,npk,8/24"
        depends on MRB_VM1_NPK

menuconfig MRB_VM1_USB_XHCI
        bool "USB xHCI"
        default y
        depends on MRB_VM1_HOSTBRIDGE

config MRB_VM1_USB_XHCI_OPT
        string "optional args"
        default "7,xhci,1-1:1-2:1-3:2-1:2-2:2-3:cap=apl"
        depends on MRB_VM1_USB_XHCI

menuconfig MRB_VM1_VIRTIO_RPMB
        bool "virtio-_rpmb"
        default y
        depends on MRB_VM1_HOSTBRIDGE

config MRB_VM1_VIRTIO_RPMB_OPT
        string "optional args"
        default "13,virtio-rpmb"
        depends on MRB_VM1_VIRTIO_RPMB

menuconfig MRB_VM1_VIRTIO_HYPER_DMABUF
        bool "virtio-hypey_dmabuf"
        default y
        depends on MRB_VM1_HOSTBRIDGE

config MRB_VM1_VIRTIO_HYPER_DMABUF_OPT
        string "optional args"
        default "10,virtio-hyper_dmabuf"
        depends on MRB_VM1_VIRTIO_HYPER_DMABUF

menuconfig MRB_VM1_WDT_I6300ESB
        bool "wdt-i6300esb"
        default y
        depends on MRB_VM1_HOSTBRIDGE

config MRB_VM1_WDT_I6300ESB_OPT
        string "optional args"
        default "11,wdt-i6300esb"
        depends on MRB_VM1_WDT_I6300ESB

menuconfig MRB_VM1_VIRTIO_BLK
        bool "virtio block device"
        default y
        depends on MRB_VM1_HOSTBRIDGE

config MRB_VM1_VIRTIO_BLK_OPT
        string "optional args"
        default "3,virtio-blk,b,/data/android/android.img"
        depends on MRB_VM1_VIRTIO_BLK

menuconfig MRB_VM1_VIRTIO_NET
        bool "virtio net device"
        default y
        depends on MRB_VM1_HOSTBRIDGE

config MRB_VM1_VIRTIO_NET_OPT
        string "optional args"
        default "9,virtio-net,tap_AaaG"
        depends on MRB_VM1_VIRTIO_NET

menuconfig MRB_VM1_VIRTIO_IPU
        bool "virtio IPU"
        default n
        depends on MRB_VM1_HOSTBRIDGE

config MRB_VM1_VIRTIO_IPU_OPT
        string "optional args"
        default "21,virtio-ipu"
        depends on MRB_VM1_VIRTIO_IPU

menuconfig MRB_VM1_PTDEV
        bool "passthrough device"
        default y
        depends on MRB_VM1_HOSTBRIDGE

menuconfig MRB_VM1_PTDEV_USB
        bool "USB passthrough"
        default y
        depends on MRB_VM1_PTDEV

config MRB_VM1_PTDEV_USB_OPT_1
        string "optional args"
        default "8,passthru,0/15/1"
        depends on MRB_VM1_PTDEV_USB

config MRB_VM1_PTDEV_USB_ID_1
        string "Device ID"
        default "8086 5aaa"
        depends on MRB_VM1_PTDEV_USB

config MRB_VM1_PTDEV_USB_DEVINFO_1
        string "Device info"
        default "0000:00:15.1"
        depends on MRB_VM1_PTDEV_USB

menuconfig MRB_VM1_PTDEV_AUDIO
        bool "audio device"
        default y
        depends on MRB_VM1_PTDEV

config MRB_VM1_PTDEV_AUDIO_OPT
        string "optional args"
        default "14,passthru,0/e/0,keep_gsi"
        depends on MRB_VM1_PTDEV_AUDIO

config MRB_VM1_PTDEV_AUDIO_ID
        string "Device ID"
        default "8086 5a98"
        depends on MRB_VM1_PTDEV_AUDIO

config MRB_VM1_PTDEV_AUDIO_DEVINFO
        string "Device info"
        default "0000:00:0e.0"
        depends on MRB_VM1_PTDEV_AUDIO

menuconfig MRB_VM1_PTDEV_AUDIO_CODEC
        bool "audio codec"
        default y
        depends on MRB_VM1_PTDEV

config MRB_VM1_PTDEV_AUDIO_CODEC_OPT
        string "optional args"
        default "23,passthru,0/17/0"
        depends on MRB_VM1_PTDEV_AUDIO_CODEC

config MRB_VM1_PTDEV_AUDIO_CODEC_ID
        string "Device ID"
        default "8086 5ab4"
        depends on MRB_VM1_PTDEV_AUDIO_CODEC

config MRB_VM1_PTDEV_AUDIO_CODEC_DEVINFO
        string "Device info"
        default "0000:00:17.0"
        depends on MRB_VM1_PTDEV_AUDIO_CODEC

menuconfig MRB_VM1_PTDEV_CSME
        bool "Converged Security Manageability Engine"
        default y
        depends on MRB_VM1_PTDEV

config MRB_VM1_PTDEV_CSME_OPT
        string "optional args"
        default "15,passthru,0/f/0"
        depends on MRB_VM1_PTDEV_CSME

config MRB_VM1_PTDEV_CSME_ID
        string "Device ID"
        default "8086 5a9a"
        depends on MRB_VM1_PTDEV_CSME

config MRB_VM1_PTDEV_CSME_DEVINFO
        string "Device info"
        default "0000:00:0f.0"
        depends on MRB_VM1_PTDEV_CSME

menuconfig MRB_VM1_PTDEV_IPU
        bool "IPU passthrough"
        default y
        depends on MRB_VM1_PTDEV

config MRB_VM1_PTDEV_IPU_OPT
        string "IPU passthrough optional args"
        default "12,passthru,0/3/0"
        depends on MRB_VM1_PTDEV_IPU

config MRB_VM1_PTDEV_IPU_ID
        string "Device ID"
        default "8086 5a88"
        depends on MRB_VM1_PTDEV_IPU

config MRB_VM1_PTDEV_IPU_DEVINFO
        string "Device info"
        default "0000:00:03.0"
        depends on MRB_VM1_PTDEV_IPU

config MRB_VM1_PTDEV_IPU_I2C
        string "Related I2C optional args"
        default "22,passthru,0/16/0"
        depends on MRB_VM1_PTDEV_IPU

config MRB_VM1_PTDEV_IPU_I2C_ID
        string "Device ID"
        default "8086 5aac"
        depends on MRB_VM1_PTDEV_IPU

config MRB_VM1_PTDEV_IPU_I2C_DEVINFO
        string "Device info"
        default "0000:00:16.0"
        depends on MRB_VM1_PTDEV_IPU

menuconfig MRB_VM1_PTDEV_SD
        bool "SD card passthrough"
        default y
        depends on MRB_VM1_PTDEV

config MRB_VM1_PTDEV_SD_OPT
        string "optional args"
        default "27,passthru,0/1b/0"
        depends on MRB_VM1_PTDEV_SD

config MRB_VM1_PTDEV_SD_ID
        string "Device ID"
        default "8086 5aca"
        depends on MRB_VM1_PTDEV_SD

config MRB_VM1_PTDEV_SD_DEVINFO
        string "Device info"
        default "0000:00:1b.0"
        depends on MRB_VM1_PTDEV_SD

menuconfig MRB_VM1_PTDEV_WIFI
        bool "wifi passthrough"
        default y
        depends on MRB_VM1_PTDEV

config MRB_VM1_PTDEV_WIFI_OPT
        string "optional args"
        default "18,passthru,3/0/0,keep_gsi"
        depends on MRB_VM1_PTDEV_WIFI

config MRB_VM1_PTDEV_WIFI_ID
        string "Device ID"
        default "11ab 2b38"
        depends on MRB_VM1_PTDEV_WIFI

config MRB_VM1_PTDEV_WIFI_DEVINFO
        string "Device info"
        default "0000:03:00.0"
        depends on MRB_VM1_PTDEV_WIFI

menuconfig MRB_VM1_PTDEV_BLUETOOTH
        bool "Bluetooth passthrough"
        default y
        depends on MRB_VM1_PTDEV

config MRB_VM1_PTDEV_BLUETOOTH_OPT
        string "optional args"
        default "24,passthru,0/18/0"
        depends on MRB_VM1_PTDEV_BLUETOOTH

config MRB_VM1_PTDEV_BLUETOOTH_ID
        string "Device ID"
        default "8086 5abc"
        depends on MRB_VM1_PTDEV_BLUETOOTH

config MRB_VM1_PTDEV_BLUETOOTH_DEVINFO
        string "Device info"
        default "0000:00:18.0"
        depends on MRB_VM1_PTDEV_BLUETOOTH

menuconfig MRB_VM1_IOC
        bool "ioc"
        default y
        depends on MRB_VM1
        select MRB_VM1_LPC_COM2

config MRB_VM1_IOC_UART
        string "Virtual Uart Path"
        default "/run/acrn/ioc_"
        depends on MRB_VM1_IOC

config MRB_VM1_IOC_REASON
        string "Wakeup Reason"
        default "0x20"
        depends on MRB_VM1_IOC

menuconfig MRB_VM1_LPC
        bool "lpc"
        default y
        depends on MRB_VM1

config MRB_VM1_LPC_OPT
        string "lpc optional args"
        default "1:0,lpc"
        depends on MRB_VM1_LPC

config MRB_VM1_LPC_COM1
        bool "lpc com1"
        default y
        depends on MRB_VM1_LPC

config MRB_VM1_LPC_COM1_OPT
        string "optional args"
        default "com1,stdio"
        depends on MRB_VM1_LPC_COM1

config MRB_VM1_LPC_COM2
        bool "lpc com2"
        default y
        depends on MRB_VM1_LPC

config MRB_VM1_LPC_COM2_OPT
        string "optional args"
        default "com2,/run/acrn/ioc_"
        depends on MRB_VM1_LPC_COM2
```
