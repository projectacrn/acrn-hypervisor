/*
 * Copyright (C) 2025 Intel Corporation.
 *
 * SPDX-License-Identifier: BSD-3-Clause
 */

OUTPUT_ARCH(riscv)
ENTRY(_start)

SECTIONS
{
	. = CONFIG_HV_RAM_START;
	_code_start = .;

	.text :
	{
		_text_start = .;
		*(.text.entry)		/* Entry point code first */
		*(.text)
		*(.text.*)
		*(.note.gnu.build-id)	/* Keep build ID for debugging */

		. = ALIGN(8);
		_text_end = .;
	}

	. = ALIGN(0x1000);
	.rodata :
	{
		_rodata_start = .;
		*(.rodata)
		*(.rodata.*)

		/* Small rodata sections */
		*(.srodata)
		*(.srodata.*)

		. = ALIGN(8);
		_rodata_end = .;
	}

	. = ALIGN(0x1000);
	.data :
	{
		_data_start = .;
		*(.data.page_aligned)
		*(.data)
		*(.data.*)

		/* Small data sections */
		*(.sdata)
		*(.sdata.*)

		. = ALIGN(8);
		_data_end = .;
	}

	. = ALIGN(0x1000);
	.boot_stack :
	{
		_boot_stack_start = .;
		. += 0x1000;
		. = ALIGN(16);		/* RISC-V ABI requires 16-byte stack alignment */
		_boot_stack_end = .;
	}

	. = ALIGN(0x1000);
	.bss (NOLOAD) :
	{
		_bss_start = .;
		*(.bss)
		*(.bss.*)

		/* Small BSS sections */
		*(.sbss)
		*(.sbss.*)

		. = ALIGN(8);
		_bss_end = .;
	}

	. = ALIGN(0x1000);
	_code_end = .;
}
